//02.03.2016
#include <Adafruit_GFX.h>
#include <Adafruit_PCD8544.h>
#include <VirtualWire.h>
#include <EEPROM.h>
Adafruit_PCD8544 display = Adafruit_PCD8544(4, 5, 6, 7, 8);
float ValRad, ValTreat; //радиация и лечение приемник
byte Device_id=1; //ID устройства
byte Group_id=1; //ID группировки
bool Deadh=false; //Мертв ли сталкер
bool DeadhSignal=false; //Повторение сигнала смерти пока не подтвердишь
bool LowVolt=false, SpeakerReady=true, LCD_Sleep; //низкий заряд батареи и запрет одновременного использования пищалки, спит ли дисплей
bool Radiation_res=false, Radiation=true; //логика радиации
bool Treat_res=false, Treat=true; //логика лечилки
float RadiationLevel=0, TreatLevel=0; //общий уровень радиации и лечилки
float RadiationMas[3]={0, 0, 0}, TreatMas[4] = {0, 0, 0, 0}; //Массивы значений от передатчиков радиации и лечилок
unsigned long RadiationMillis[3]={0,0,0}, TreatMillis[3]={0,0,0};
int OutDevice[13] = {70, 120, 198, 276, 361, 454, 532, 605, 676, 756, 859, 943, 953}; //АЦП артефактов и админ устройств
int KeysACP[5] = {890, 716, 512, 341, 787}; // АЦП кнопок
byte DeviceID=0, ArtefaktID=0; //Номер подключенного устройства
bool Device=false, Artefakt=false, Key=false; //Логика устройств внешних и нажатия кнопок меню
byte Health=84, PrHealth=101; //Хэлсы персонажа
unsigned long PrMillisRad=0, PrMillisBat=0, PrMillisTreat=0, MillisSpeaker=0, PrDisplayLedTime=0, PrMillisAffect=0, PrMillisChangeDisplayPg=0, PrMillisDisplayRefresh=0; //Для отсчета времени
byte VbatPin=0, AdminDevPin=2,ArtefaktPin=3, KeysPin=1, SpeakerPin=10, LedPin=3, receive_pin = 11; //Пины контроллера
byte Volt, BatICO=123; //Заряд батареи в процентах и адрес иконки батареи в зависимости от заряда
float RadiationKoef=1; //Коэффициент воздействия радиации на игрока
float PoisonKoef=1; //Коэффициент воздействия яда на игрока
int DisplayLedTime=30000; // Время подсветки дисплея
byte DisplayBright=200, DisplayPage=31; // Якрость подсветки дисплея и номер отображаемой страницы дисплея
byte Messages=0; //Кол-во непрочитанных сообщений
bool SignalAffect=false; //Для того, чтобы попискивала при воздействии вредных факторов
bool Mute=false; //Глушилка звука
bool DisplayChange=false; // Переключение дисплея при воздействии заразы
char MA[71]={0}; //Для принятых текстовых сообщений через радиопередатчик
char M[71]={0}; //Для вывода сообщений на экран
bool MessageMas[30]={0,0,0,0,0,0,0,0,0,0,0,0,0,0,0,0,0,0,0,0,0,0,0,0,0,0,0,0,0,0}; //Массив непрочитанных сообщений
bool SMS_reciver[5]={0,0,0,0,0}; //Исключение получения сообщений, которые уже получал.
bool ReadMesMas[25]={0,0,0,0,0,0,0,0,0,0,0,0,0,0,0,0,0,0,0,0,0,0,0,0,0}; //Исключение получения сообщений, которые уже получал.
bool ZarazaMas[10]={0,0,0,0,0,0,0,0,0,0}; //Массив заразы, которую можно получить
bool ZarazaUse[10]={0,0,0,0,0,0,0,0,0,0};//Исключение получения заразы, от которой уже вылечился
bool Zaraza=false;//Гадость
byte Poison=0; // Уровень яда
uint8_t buf[VW_MAX_MESSAGE_LEN];
uint8_t buflen = VW_MAX_MESSAGE_LEN;

void setup() {
//EEPROM_READ();
NoReadMessages();
analogWrite(LedPin, DisplayBright);
  pinMode(SpeakerPin, OUTPUT);
  pinMode(LedPin, OUTPUT);
  display.begin();
  display.setContrast(60);
  delay(3000);
  LCD(1);

    Serial.begin(9600);  // Debugging only
    Serial.println("setup");
    
    // Initialise the IO and ISR
    vw_set_rx_pin(receive_pin);
    vw_set_ptt_inverted(true); // Required for DR3100
    vw_setup(2000);  // Bits per sec
    vw_rx_start();       // Start the receiver PLL running
  Volt=GetVoltage(VbatPin, 6.8, 8.0, 2.0);
    digitalWrite(SpeakerPin, LOW);
    randomSeed(analogRead(4));
}

void EEPROM_READ() {
Health=EEPROM.read(0);
for (byte i=1;i<=10;i++) {ZarazaMas[i-1]=EEPROM.read(i);}
DisplayBright=EEPROM.read(11);
}

void GetMes() {

    if (vw_get_message(buf, &buflen)) // Non-blocking
    {
ValRad=0; ValTreat=0;
  byte k=0;
  if (buf[0]=='R' && buf[1]=='a' && buf[2]=='d' && buf[3]=='i' && buf[4]=='a') {
  k=buf[5];
  ValRad+=10*buf[6];ValRad+=buf[7];ValRad+=0.1*buf[8];ValRad+=0.01*buf[9];
  RadiationMillis[k]=millis();
  RadiationMas[k]=ValRad;
  if (!Radiation) Radiation=true;
  } // Радиация
  
    if (buf[0]=='T' && buf[1]=='r' && buf[2]=='e' && buf[3]=='a' && buf[4]=='t') {
    k=buf[5];
    ValTreat+=10*buf[6];ValTreat+=buf[7];ValTreat+=0.1*buf[8];ValTreat+=0.01*buf[9];
    TreatMillis[k]=millis();
    TreatMas[k]=ValTreat;
    if (!Treat) Treat=true;
    } // Лечение
        if (buf[0]=='D' && buf[1]=='e' && buf[2]=='a' && buf[3]=='d' && buf[4]=='h') Deadh_Stalker();

    if (buf[0]=='M' && buf[1]=='e' && buf[2]=='s' && buf[3]=='s' && buf[4]=='A') {
    NewSMS(buf[5], buf[6], buf[7], buf[8], buf[9], buf[10]);
    }
    
    }
}
void ReadNewSMS(byte MesNum) {
  if (MesNum<5) {
  if (!SMS_reciver[MesNum]) {
  byte cnt=0;    
  for (int i=0;i<5;i++) {if (i!=MesNum) {SMS_reciver[i]=false;MessageMas[i+25]=false;}
  else {SMS_reciver[i]=true;MessageMas[i+25]=true;}}
  for (int i=1;buf[i+10]!=0;i++) {MA[cnt]=buf[i+10];cnt++;}
  MA[cnt]=0;
  Signal(6);
  NoReadMessages();
  }}
  if (MesNum>4 && MesNum<30) {
   if (!ReadMesMas[MesNum-5]) {
    ReadMesMas[MesNum-5]=true;
    MessageMas[MesNum-5]=true;
    Signal(6);
    NoReadMessages();
   }
  }
    if (MesNum>29 && MesNum<40) {
      if (!ZarazaUse[MesNum-30] && !Zaraza) {
        Zaraza=true;
        ZarazaUse[MesNum-30]=true;
        ZarazaMas[MesNum-30]=true;
        Signal(6);delay(50);Signal(6);delay(50);Signal(6);delay(50);Signal(6);delay(50);Signal(6);
      }
    }
    
 
}


void NewSMS(byte MesNum, byte Rate, byte Id_group, byte Id_dev, byte Id_groupExclude, byte ID_deviceExclude) {
if (Device_id!=ID_deviceExclude || ID_deviceExclude==0) 
if (Group_id!=Id_groupExclude || Id_groupExclude==0)  
if (Id_dev==Device_id || Id_dev==0)
if (Id_group==Group_id || Id_group==0){
  byte rnd_rate=random(100);
  rnd_rate++;
  if (rnd_rate<Rate) ReadNewSMS(MesNum);
  }
}

void TransmitRadiation() {
for (byte i=0;i<3;i++) {if (millis()-RadiationMillis[i] > 3000) RadiationMas[i]=0;
if (millis()-TreatMillis[i] > 5000) TreatMas[i]=0;}
}

void Radiation_zone (int Heal, int Millis) { //Радиация
    if (!Deadh)
    if ((millis()-PrMillisRad)>=Millis) {
      PrMillisRad=millis();
      Health=Health-Heal;
    }
}
void Treat_zone (int Heal, long Millis) { //Лечилка
    if ((millis()-PrMillisTreat)>=Millis) {
    PrMillisTreat=millis();
    Health=Health+Heal;
    }
if (DeadhSignal) {DeadhSignal=false;LCD(1);}
}

void Life() { // Проверка жизни сталкера
if (Health>100 && Health <110) Health=100;
if (Health<0 || Health >=110) Deadh_Stalker();
if (Health ==0 && !Deadh) Deadh_Stalker();
if (Health ==100 && Deadh) Restore_Stalker();
}

void Deadh_Stalker() { // Сталкер умер
  TreatMas[3]=0;
  Artefakt=false;
  ArtefaktID=0;
  RadiationKoef=1;
  PoisonKoef=1;
  Poison=0;
  Deadh=true;
  DeadhSignal=true;
  Messages=0;
  Zaraza=false;
  for (byte k=0;k<3;k++) {RadiationMas[k]=0;TreatMas[k]=0;}
  for (byte k=0;k<10;k++) ZarazaMas[k]=0;
  Health=0;
  LCD(1);
  Signal(1);
}
void Restore_Stalker() { //Сталкер ожил
  Deadh=false;
  DeadhSignal=false;
  LCD(1);
  Signal(2);
}
void SignalRadiation() { //Подача сигнала радиации (счетчик гейгера)
  if (SpeakerReady) {
  int SignMn=0;
  if (RadiationLevel<1) SignMn=RadiationLevel*1300 + random(1000);
  if (RadiationLevel>=1 && RadiationLevel<=5) SignMn=1600 + RadiationLevel*100 + random(200);
  if (RadiationLevel>5) SignMn=2100+random(200);
  if (millis()-MillisSpeaker > (2300 - SignMn)) {
    MillisSpeaker=millis();
    digitalWrite(SpeakerPin, HIGH);                         
    delay(3);          
    digitalWrite(SpeakerPin, LOW); 
  }
  }
}
void Signal(byte Val) { //Подача сигналов пищалкой
  SpeakerReady=false;
switch (Val) {
  case 1:
  //умер
  digitalWrite(SpeakerPin, HIGH);                                                
  delay(2000);          
  digitalWrite(SpeakerPin, LOW);
  break;
  case 2:
  //восстановился
  digitalWrite(SpeakerPin, HIGH);                         
  delay(1500);          
  digitalWrite(SpeakerPin, LOW);
  break;
  case 3:
  //админ устройство Артефакт подключены
  digitalWrite(SpeakerPin, HIGH);                         
  delay(50);          
  digitalWrite(SpeakerPin, LOW);
  delay(50);
  digitalWrite(SpeakerPin, HIGH);                         
  delay(100);          
  digitalWrite(SpeakerPin, LOW);
  break;
  case 4:
  //админ устройство Артефакт отключены
  digitalWrite(SpeakerPin, HIGH);                         
  delay(100);          
  digitalWrite(SpeakerPin, LOW); 
  delay(50);
  digitalWrite(SpeakerPin, HIGH);                         
  delay(50);          
  digitalWrite(SpeakerPin, LOW); 
  break;
  case 5:
  //Села батарея
  digitalWrite(SpeakerPin, HIGH);                         
  delay(30);     
  digitalWrite(SpeakerPin, LOW);  
  delay(30);      
  digitalWrite(SpeakerPin, HIGH);                         
  delay(30);     
  digitalWrite(SpeakerPin, LOW); 
  delay(30);  
  digitalWrite(SpeakerPin, HIGH);                         
  delay(30);     
  digitalWrite(SpeakerPin, LOW); 
  delay(30);  
  digitalWrite(SpeakerPin, HIGH);                         
  delay(30);     
  digitalWrite(SpeakerPin, LOW); 
  break;
}

if (!Mute)  switch (Val) {
    case 6:
  //SMS
  digitalWrite(SpeakerPin, HIGH);                         
  delay(70);     
  digitalWrite(SpeakerPin, LOW);  
  delay(50);      
  digitalWrite(SpeakerPin, HIGH);                         
  delay(70);     
  digitalWrite(SpeakerPin, LOW); 
  delay(50);  
  digitalWrite(SpeakerPin, HIGH);                         
  delay(70);     
  digitalWrite(SpeakerPin, LOW); 
  break;
  case 7:
  //Дурной эффект
  digitalWrite(SpeakerPin, HIGH);                          
  delay(300);     
  digitalWrite(SpeakerPin, LOW);   
  SignalAffect=false;  
  break;
  }
SpeakerReady=true;
}

void LCD_Refresh(){
  if (!LCD_Sleep) LCD(2);
}

int GetVoltage(int PinBat, float MinVolt, float MaxVolt, float KF) { //Проверка заряда батареи
  float Min=(MinVolt*204.8)/KF;
  float Max=(MaxVolt*204.8)/KF;
  int Volt1 = analogRead(PinBat);
  int VoltPerc=0;
  float Ind1 = (Max-Min) / 100;
  if (Volt1 < Min) {VoltPerc=0;}
  else {
  VoltPerc = (Volt1 - Min) / Ind1;
  if (VoltPerc>100) VoltPerc=100;}
  if ((VoltPerc<10) && !LowVolt) {LowVolt=true; DisplayLedTime=5000; DisplayBright=50;}
  if ((VoltPerc>10) && LowVolt) {LowVolt=false; DisplayLedTime=30000; DisplayBright=200;}
  if (VoltPerc/20 >= 5) BatICO=127;
  else BatICO=123+VoltPerc/20;
  if (LowVolt) Signal(5);
  return VoltPerc;
}

void PrintSMS() {
display.setCursor(0,8);
switch(DisplayPage) {
  case 0:
M[0]='П';M[1]='о';M[2]='я';M[3]='в';M[4]='и';M[5]='л';M[6]='а';M[7]='с';M[8]='ь';M[9]=' ';M[10]='с';M[11]='т';M[12]='р';M[13]='а';M[14]='н';M[15]='н';M[16]='а';M[17]='я';M[18]=' ';M[19]='с';M[20]='ы';M[21]='п';M[22]='ь';M[23]=',';M[24]=' ';M[25]='х';
M[26]='е';M[27]='р';M[28]='о';M[29]='в';M[30]='о';M[31]=' ';M[32]='с';M[33]='е';M[34]='б';M[35]='я';M[36]=' ';M[37]='ч';M[38]='у';M[39]='в';M[40]='с';M[41]='т';M[42]='в';M[43]='у';M[44]='ю';M[45]='.';M[46]=' ';M[47]='Н';M[48]='а';M[49]='д';M[50]='о';
M[51]=' ';M[52]='б';M[53]='е';M[54]='ж';M[55]='а';M[56]='т';M[57]='ь';M[58]=' ';M[59]='к';M[60]=' ';M[61]='у';M[62]='ч';M[63]='е';M[64]='н';M[65]='ы';M[66]='м';M[67]='!';M[68]='!';M[69]='!';M[70]=0;
  break;
  case 1:
M[0]='2';M[1]='о';M[2]='г';M[3]='о';M[4]='в';M[5]='а';M[6]='р';M[7]='и';M[8]='в';M[9]='а';M[10]='ю';M[11]='т';M[12]=' ';M[13]='х';M[14]='о';M[15]='д';M[16]='о';M[17]='к';M[18]='и';M[19]=' ';M[20]='т';M[21]='а';M[22]='щ';M[23]='а';M[24]='т';M[25]=' ';
M[26]='б';M[27]='о';M[28]='м';M[29]='б';M[30]='у';M[31]=' ';M[32]='в';M[33]=' ';M[34]='з';M[35]='о';M[36]='н';M[37]='у';M[38]='!';M[39]=' ';M[40]='К';M[41]='а';M[42]='к';M[43]='-';M[44]='б';M[45]='ы';M[46]=' ';M[47]='д';M[48]='е';M[49]='л';M[50]='о';
M[51]='в';M[52]=' ';M[53]='н';M[54]='а';M[55]=' ';M[56]='н';M[57]='а';M[58]='в';M[59]='о';M[60]='р';M[61]='о';M[62]='т';M[63]='и';M[64]='л';M[65]='и';M[66]='!';M[67]=0;
  break;
  case 2:
M[0]='3';M[1]='ы';M[2]=' ';M[3]='м';M[4]='а';M[5]='т';M[6]='р';M[7]='о';M[8]='с';M[9]='ы';M[10]=',';M[11]=' ';M[12]='м';M[13]='ы';M[14]=' ';M[15]='м';M[16]='а';M[17]='т';M[18]='р';M[19]='о';M[20]='с';M[21]='ы';M[22]='.';M[23]=' ';M[24]='М';M[25]='ы';
M[26]=' ';M[27]='н';M[28]='е';M[29]=' ';M[30]='к';M[31]='у';M[32]='р';M[33]='и';M[34]='м';M[35]=' ';M[36]='п';M[37]='а';M[38]='п';M[39]='и';M[40]='р';M[41]='о';M[42]='с';M[43]='ы';M[44]='!';M[45]=' ';M[46]='В';M[47]='ы';M[48]='г';M[49]='л';M[50]='я';
M[51]='д';M[52]='и';M[53]='м';M[54]=' ';M[55]='в';M[56]='п';M[57]='о';M[58]='л';M[59]='н';M[60]='е';M[61]=' ';M[62]='к';M[63]='о';M[64]='н';M[65]='к';M[66]='р';M[67]='е';M[68]='т';M[69]='н';M[70]='о';M[71]=0;
  break;
  case 3:
 M[0]='4';M[1]='о';M[2]='г';M[3]='о';M[4]='в';M[5]='а';M[6]='р';M[7]='и';M[8]='в';M[9]='а';M[10]='ю';M[11]='т';M[12]=' ';M[13]='х';M[14]='о';M[15]='д';M[16]='о';M[17]='к';M[18]='и';M[19]=' ';M[20]='т';M[21]='а';M[22]='щ';M[23]='а';M[24]='т';M[25]=' ';
M[26]='б';M[27]='о';M[28]='м';M[29]='б';M[30]='у';M[31]=' ';M[32]='в';M[33]=' ';M[34]='з';M[35]='о';M[36]='н';M[37]='у';M[38]='!';M[39]=' ';M[40]='К';M[41]='а';M[42]='к';M[43]='-';M[44]='б';M[45]='ы';M[46]=' ';M[47]='д';M[48]='е';M[49]='л';M[50]='о';
M[51]='в';M[52]=' ';M[53]='н';M[54]='а';M[55]=' ';M[56]='н';M[57]='а';M[58]='в';M[59]='о';M[60]='р';M[61]='о';M[62]='т';M[63]='и';M[64]='л';M[65]='и';M[66]='!';M[67]=0;
  break;
  case 4:
M[0]='5';M[1]='о';M[2]='г';M[3]='о';M[4]='в';M[5]='а';M[6]='р';M[7]='и';M[8]='в';M[9]='а';M[10]='ю';M[11]='т';M[12]=' ';M[13]='х';M[14]='о';M[15]='д';M[16]='о';M[17]='к';M[18]='и';M[19]=' ';M[20]='т';M[21]='а';M[22]='щ';M[23]='а';M[24]='т';M[25]=' ';
M[26]='б';M[27]='о';M[28]='м';M[29]='б';M[30]='у';M[31]=' ';M[32]='в';M[33]=' ';M[34]='з';M[35]='о';M[36]='н';M[37]='у';M[38]='!';M[39]=' ';M[40]='К';M[41]='а';M[42]='к';M[43]='-';M[44]='б';M[45]='ы';M[46]=' ';M[47]='д';M[48]='е';M[49]='л';M[50]='о';
M[51]='в';M[52]=' ';M[53]='н';M[54]='а';M[55]=' ';M[56]='н';M[57]='а';M[58]='в';M[59]='о';M[60]='р';M[61]='о';M[62]='т';M[63]='и';M[64]='л';M[65]='и';M[66]='!';M[67]=0;
  break;
  case 5:
M[0]='6';M[1]='о';M[2]='г';M[3]='о';M[4]='в';M[5]='а';M[6]='р';M[7]='и';M[8]='в';M[9]='а';M[10]='ю';M[11]='т';M[12]=' ';M[13]='х';M[14]='о';M[15]='д';M[16]='о';M[17]='к';M[18]='и';M[19]=' ';M[20]='т';M[21]='а';M[22]='щ';M[23]='а';M[24]='т';M[25]=' ';
M[26]='б';M[27]='о';M[28]='м';M[29]='б';M[30]='у';M[31]=' ';M[32]='в';M[33]=' ';M[34]='з';M[35]='о';M[36]='н';M[37]='у';M[38]='!';M[39]=' ';M[40]='К';M[41]='а';M[42]='к';M[43]='-';M[44]='б';M[45]='ы';M[46]=' ';M[47]='д';M[48]='е';M[49]='л';M[50]='о';
M[51]='в';M[52]=' ';M[53]='н';M[54]='а';M[55]=' ';M[56]='н';M[57]='а';M[58]='в';M[59]='о';M[60]='р';M[61]='о';M[62]='т';M[63]='и';M[64]='л';M[65]='и';M[66]='!';M[67]=0;  
  break;
  case 6:
M[0]='7';M[1]='о';M[2]='г';M[3]='о';M[4]='в';M[5]='а';M[6]='р';M[7]='и';M[8]='в';M[9]='а';M[10]='ю';M[11]='т';M[12]=' ';M[13]='х';M[14]='о';M[15]='д';M[16]='о';M[17]='к';M[18]='и';M[19]=' ';M[20]='т';M[21]='а';M[22]='щ';M[23]='а';M[24]='т';M[25]=' ';
M[26]='б';M[27]='о';M[28]='м';M[29]='б';M[30]='у';M[31]=' ';M[32]='в';M[33]=' ';M[34]='з';M[35]='о';M[36]='н';M[37]='у';M[38]='!';M[39]=' ';M[40]='К';M[41]='а';M[42]='к';M[43]='-';M[44]='б';M[45]='ы';M[46]=' ';M[47]='д';M[48]='е';M[49]='л';M[50]='о';
M[51]='в';M[52]=' ';M[53]='н';M[54]='а';M[55]=' ';M[56]='н';M[57]='а';M[58]='в';M[59]='о';M[60]='р';M[61]='о';M[62]='т';M[63]='и';M[64]='л';M[65]='и';M[66]='!';M[67]=0;  
  break;
  case 7:
M[0]='8';M[1]='о';M[2]='г';M[3]='о';M[4]='в';M[5]='а';M[6]='р';M[7]='и';M[8]='в';M[9]='а';M[10]='ю';M[11]='т';M[12]=' ';M[13]='х';M[14]='о';M[15]='д';M[16]='о';M[17]='к';M[18]='и';M[19]=' ';M[20]='т';M[21]='а';M[22]='щ';M[23]='а';M[24]='т';M[25]=' ';
M[26]='б';M[27]='о';M[28]='м';M[29]='б';M[30]='у';M[31]=' ';M[32]='в';M[33]=' ';M[34]='з';M[35]='о';M[36]='н';M[37]='у';M[38]='!';M[39]=' ';M[40]='К';M[41]='а';M[42]='к';M[43]='-';M[44]='б';M[45]='ы';M[46]=' ';M[47]='д';M[48]='е';M[49]='л';M[50]='о';
M[51]='в';M[52]=' ';M[53]='н';M[54]='а';M[55]=' ';M[56]='н';M[57]='а';M[58]='в';M[59]='о';M[60]='р';M[61]='о';M[62]='т';M[63]='и';M[64]='л';M[65]='и';M[66]='!';M[67]=0; 
  break;
  case 8:
M[0]='9';M[1]='о';M[2]='г';M[3]='о';M[4]='в';M[5]='а';M[6]='р';M[7]='и';M[8]='в';M[9]='а';M[10]='ю';M[11]='т';M[12]=' ';M[13]='х';M[14]='о';M[15]='д';M[16]='о';M[17]='к';M[18]='и';M[19]=' ';M[20]='т';M[21]='а';M[22]='щ';M[23]='а';M[24]='т';M[25]=' ';
M[26]='б';M[27]='о';M[28]='м';M[29]='б';M[30]='у';M[31]=' ';M[32]='в';M[33]=' ';M[34]='з';M[35]='о';M[36]='н';M[37]='у';M[38]='!';M[39]=' ';M[40]='К';M[41]='а';M[42]='к';M[43]='-';M[44]='б';M[45]='ы';M[46]=' ';M[47]='д';M[48]='е';M[49]='л';M[50]='о';
M[51]='в';M[52]=' ';M[53]='н';M[54]='а';M[55]=' ';M[56]='н';M[57]='а';M[58]='в';M[59]='о';M[60]='р';M[61]='о';M[62]='т';M[63]='и';M[64]='л';M[65]='и';M[66]='!';M[67]=0;  
  break;
  case 9:
M[0]='1';M[1]='0';M[2]='г';M[3]='о';M[4]='в';M[5]='а';M[6]='р';M[7]='и';M[8]='в';M[9]='а';M[10]='ю';M[11]='т';M[12]=' ';M[13]='х';M[14]='о';M[15]='д';M[16]='о';M[17]='к';M[18]='и';M[19]=' ';M[20]='т';M[21]='а';M[22]='щ';M[23]='а';M[24]='т';M[25]=' ';
M[26]='б';M[27]='о';M[28]='м';M[29]='б';M[30]='у';M[31]=' ';M[32]='в';M[33]=' ';M[34]='з';M[35]='о';M[36]='н';M[37]='у';M[38]='!';M[39]=' ';M[40]='К';M[41]='а';M[42]='к';M[43]='-';M[44]='б';M[45]='ы';M[46]=' ';M[47]='д';M[48]='е';M[49]='л';M[50]='о';
M[51]='в';M[52]=' ';M[53]='н';M[54]='а';M[55]=' ';M[56]='н';M[57]='а';M[58]='в';M[59]='о';M[60]='р';M[61]='о';M[62]='т';M[63]='и';M[64]='л';M[65]='и';M[66]='!';M[67]=0; 
  break;
  case 10:
M[0]='1';M[1]='1';M[2]='г';M[3]='о';M[4]='в';M[5]='а';M[6]='р';M[7]='и';M[8]='в';M[9]='а';M[10]='ю';M[11]='т';M[12]=' ';M[13]='х';M[14]='о';M[15]='д';M[16]='о';M[17]='к';M[18]='и';M[19]=' ';M[20]='т';M[21]='а';M[22]='щ';M[23]='а';M[24]='т';M[25]=' ';
M[26]='б';M[27]='о';M[28]='м';M[29]='б';M[30]='у';M[31]=' ';M[32]='в';M[33]=' ';M[34]='з';M[35]='о';M[36]='н';M[37]='у';M[38]='!';M[39]=' ';M[40]='К';M[41]='а';M[42]='к';M[43]='-';M[44]='б';M[45]='ы';M[46]=' ';M[47]='д';M[48]='е';M[49]='л';M[50]='о';
M[51]='в';M[52]=' ';M[53]='н';M[54]='а';M[55]=' ';M[56]='н';M[57]='а';M[58]='в';M[59]='о';M[60]='р';M[61]='о';M[62]='т';M[63]='и';M[64]='л';M[65]='и';M[66]='!';M[67]=0; 
  break;
  case 11:
M[0]='1';M[1]='2';M[2]='г';M[3]='о';M[4]='в';M[5]='а';M[6]='р';M[7]='и';M[8]='в';M[9]='а';M[10]='ю';M[11]='т';M[12]=' ';M[13]='х';M[14]='о';M[15]='д';M[16]='о';M[17]='к';M[18]='и';M[19]=' ';M[20]='т';M[21]='а';M[22]='щ';M[23]='а';M[24]='т';M[25]=' ';
M[26]='б';M[27]='о';M[28]='м';M[29]='б';M[30]='у';M[31]=' ';M[32]='в';M[33]=' ';M[34]='з';M[35]='о';M[36]='н';M[37]='у';M[38]='!';M[39]=' ';M[40]='К';M[41]='а';M[42]='к';M[43]='-';M[44]='б';M[45]='ы';M[46]=' ';M[47]='д';M[48]='е';M[49]='л';M[50]='о';
M[51]='в';M[52]=' ';M[53]='н';M[54]='а';M[55]=' ';M[56]='н';M[57]='а';M[58]='в';M[59]='о';M[60]='р';M[61]='о';M[62]='т';M[63]='и';M[64]='л';M[65]='и';M[66]='!';M[67]=0;
  break;
  case 12:
M[0]='1';M[1]='3';M[2]='г';M[3]='о';M[4]='в';M[5]='а';M[6]='р';M[7]='и';M[8]='в';M[9]='а';M[10]='ю';M[11]='т';M[12]=' ';M[13]='х';M[14]='о';M[15]='д';M[16]='о';M[17]='к';M[18]='и';M[19]=' ';M[20]='т';M[21]='а';M[22]='щ';M[23]='а';M[24]='т';M[25]=' ';
M[26]='б';M[27]='о';M[28]='м';M[29]='б';M[30]='у';M[31]=' ';M[32]='в';M[33]=' ';M[34]='з';M[35]='о';M[36]='н';M[37]='у';M[38]='!';M[39]=' ';M[40]='К';M[41]='а';M[42]='к';M[43]='-';M[44]='б';M[45]='ы';M[46]=' ';M[47]='д';M[48]='е';M[49]='л';M[50]='о';
M[51]='в';M[52]=' ';M[53]='н';M[54]='а';M[55]=' ';M[56]='н';M[57]='а';M[58]='в';M[59]='о';M[60]='р';M[61]='о';M[62]='т';M[63]='и';M[64]='л';M[65]='и';M[66]='!';M[67]=0;
  break;
  case 13:
M[0]='1';M[1]='4';M[2]='г';M[3]='о';M[4]='в';M[5]='а';M[6]='р';M[7]='и';M[8]='в';M[9]='а';M[10]='ю';M[11]='т';M[12]=' ';M[13]='х';M[14]='о';M[15]='д';M[16]='о';M[17]='к';M[18]='и';M[19]=' ';M[20]='т';M[21]='а';M[22]='щ';M[23]='а';M[24]='т';M[25]=' ';
M[26]='б';M[27]='о';M[28]='м';M[29]='б';M[30]='у';M[31]=' ';M[32]='в';M[33]=' ';M[34]='з';M[35]='о';M[36]='н';M[37]='у';M[38]='!';M[39]=' ';M[40]='К';M[41]='а';M[42]='к';M[43]='-';M[44]='б';M[45]='ы';M[46]=' ';M[47]='д';M[48]='е';M[49]='л';M[50]='о';
M[51]='в';M[52]=' ';M[53]='н';M[54]='а';M[55]=' ';M[56]='н';M[57]='а';M[58]='в';M[59]='о';M[60]='р';M[61]='о';M[62]='т';M[63]='и';M[64]='л';M[65]='и';M[66]='!';M[67]=0;  
  break;
  case 14:
M[0]='1';M[1]='5';M[2]='г';M[3]='о';M[4]='в';M[5]='а';M[6]='р';M[7]='и';M[8]='в';M[9]='а';M[10]='ю';M[11]='т';M[12]=' ';M[13]='х';M[14]='о';M[15]='д';M[16]='о';M[17]='к';M[18]='и';M[19]=' ';M[20]='т';M[21]='а';M[22]='щ';M[23]='а';M[24]='т';M[25]=' ';
M[26]='б';M[27]='о';M[28]='м';M[29]='б';M[30]='у';M[31]=' ';M[32]='в';M[33]=' ';M[34]='з';M[35]='о';M[36]='н';M[37]='у';M[38]='!';M[39]=' ';M[40]='К';M[41]='а';M[42]='к';M[43]='-';M[44]='б';M[45]='ы';M[46]=' ';M[47]='д';M[48]='е';M[49]='л';M[50]='о';
M[51]='в';M[52]=' ';M[53]='н';M[54]='а';M[55]=' ';M[56]='н';M[57]='а';M[58]='в';M[59]='о';M[60]='р';M[61]='о';M[62]='т';M[63]='и';M[64]='л';M[65]='и';M[66]='!';M[67]=0;
  break;
  case 15:
M[0]='1';M[1]='6';M[2]='г';M[3]='о';M[4]='в';M[5]='а';M[6]='р';M[7]='и';M[8]='в';M[9]='а';M[10]='ю';M[11]='т';M[12]=' ';M[13]='х';M[14]='о';M[15]='д';M[16]='о';M[17]='к';M[18]='и';M[19]=' ';M[20]='т';M[21]='а';M[22]='щ';M[23]='а';M[24]='т';M[25]=' ';
M[26]='б';M[27]='о';M[28]='м';M[29]='б';M[30]='у';M[31]=' ';M[32]='в';M[33]=' ';M[34]='з';M[35]='о';M[36]='н';M[37]='у';M[38]='!';M[39]=' ';M[40]='К';M[41]='а';M[42]='к';M[43]='-';M[44]='б';M[45]='ы';M[46]=' ';M[47]='д';M[48]='е';M[49]='л';M[50]='о';
M[51]='в';M[52]=' ';M[53]='н';M[54]='а';M[55]=' ';M[56]='н';M[57]='а';M[58]='в';M[59]='о';M[60]='р';M[61]='о';M[62]='т';M[63]='и';M[64]='л';M[65]='и';M[66]='!';M[67]=0; 
  break;
  case 16:
M[0]='1';M[1]='7';M[2]='г';M[3]='о';M[4]='в';M[5]='а';M[6]='р';M[7]='и';M[8]='в';M[9]='а';M[10]='ю';M[11]='т';M[12]=' ';M[13]='х';M[14]='о';M[15]='д';M[16]='о';M[17]='к';M[18]='и';M[19]=' ';M[20]='т';M[21]='а';M[22]='щ';M[23]='а';M[24]='т';M[25]=' ';
M[26]='б';M[27]='о';M[28]='м';M[29]='б';M[30]='у';M[31]=' ';M[32]='в';M[33]=' ';M[34]='з';M[35]='о';M[36]='н';M[37]='у';M[38]='!';M[39]=' ';M[40]='К';M[41]='а';M[42]='к';M[43]='-';M[44]='б';M[45]='ы';M[46]=' ';M[47]='д';M[48]='е';M[49]='л';M[50]='о';
M[51]='в';M[52]=' ';M[53]='н';M[54]='а';M[55]=' ';M[56]='н';M[57]='а';M[58]='в';M[59]='о';M[60]='р';M[61]='о';M[62]='т';M[63]='и';M[64]='л';M[65]='и';M[66]='!';M[67]=0;
  break;
  case 17:
M[0]='1';M[1]='8';M[2]='г';M[3]='о';M[4]='в';M[5]='а';M[6]='р';M[7]='и';M[8]='в';M[9]='а';M[10]='ю';M[11]='т';M[12]=' ';M[13]='х';M[14]='о';M[15]='д';M[16]='о';M[17]='к';M[18]='и';M[19]=' ';M[20]='т';M[21]='а';M[22]='щ';M[23]='а';M[24]='т';M[25]=' ';
M[26]='б';M[27]='о';M[28]='м';M[29]='б';M[30]='у';M[31]=' ';M[32]='в';M[33]=' ';M[34]='з';M[35]='о';M[36]='н';M[37]='у';M[38]='!';M[39]=' ';M[40]='К';M[41]='а';M[42]='к';M[43]='-';M[44]='б';M[45]='ы';M[46]=' ';M[47]='д';M[48]='е';M[49]='л';M[50]='о';
M[51]='в';M[52]=' ';M[53]='н';M[54]='а';M[55]=' ';M[56]='н';M[57]='а';M[58]='в';M[59]='о';M[60]='р';M[61]='о';M[62]='т';M[63]='и';M[64]='л';M[65]='и';M[66]='!';M[67]=0;
  break;
  case 18:
M[0]='1';M[1]='9';M[2]='г';M[3]='о';M[4]='в';M[5]='а';M[6]='р';M[7]='и';M[8]='в';M[9]='а';M[10]='ю';M[11]='т';M[12]=' ';M[13]='х';M[14]='о';M[15]='д';M[16]='о';M[17]='к';M[18]='и';M[19]=' ';M[20]='т';M[21]='а';M[22]='щ';M[23]='а';M[24]='т';M[25]=' ';
M[26]='б';M[27]='о';M[28]='м';M[29]='б';M[30]='у';M[31]=' ';M[32]='в';M[33]=' ';M[34]='з';M[35]='о';M[36]='н';M[37]='у';M[38]='!';M[39]=' ';M[40]='К';M[41]='а';M[42]='к';M[43]='-';M[44]='б';M[45]='ы';M[46]=' ';M[47]='д';M[48]='е';M[49]='л';M[50]='о';
M[51]='в';M[52]=' ';M[53]='н';M[54]='а';M[55]=' ';M[56]='н';M[57]='а';M[58]='в';M[59]='о';M[60]='р';M[61]='о';M[62]='т';M[63]='и';M[64]='л';M[65]='и';M[66]='!';M[67]=0;  
  break;
  case 19:
M[0]='2';M[1]='0';M[2]='г';M[3]='о';M[4]='в';M[5]='а';M[6]='р';M[7]='и';M[8]='в';M[9]='а';M[10]='ю';M[11]='т';M[12]=' ';M[13]='х';M[14]='о';M[15]='д';M[16]='о';M[17]='к';M[18]='и';M[19]=' ';M[20]='т';M[21]='а';M[22]='щ';M[23]='а';M[24]='т';M[25]=' ';
M[26]='б';M[27]='о';M[28]='м';M[29]='б';M[30]='у';M[31]=' ';M[32]='в';M[33]=' ';M[34]='з';M[35]='о';M[36]='н';M[37]='у';M[38]='!';M[39]=' ';M[40]='К';M[41]='а';M[42]='к';M[43]='-';M[44]='б';M[45]='ы';M[46]=' ';M[47]='д';M[48]='е';M[49]='л';M[50]='о';
M[51]='в';M[52]=' ';M[53]='н';M[54]='а';M[55]=' ';M[56]='н';M[57]='а';M[58]='в';M[59]='о';M[60]='р';M[61]='о';M[62]='т';M[63]='и';M[64]='л';M[65]='и';M[66]='!';M[67]=0;
  break;
  case 20:
M[0]='2';M[1]='1';M[2]='г';M[3]='о';M[4]='в';M[5]='а';M[6]='р';M[7]='и';M[8]='в';M[9]='а';M[10]='ю';M[11]='т';M[12]=' ';M[13]='х';M[14]='о';M[15]='д';M[16]='о';M[17]='к';M[18]='и';M[19]=' ';M[20]='т';M[21]='а';M[22]='щ';M[23]='а';M[24]='т';M[25]=' ';
M[26]='б';M[27]='о';M[28]='м';M[29]='б';M[30]='у';M[31]=' ';M[32]='в';M[33]=' ';M[34]='з';M[35]='о';M[36]='н';M[37]='у';M[38]='!';M[39]=' ';M[40]='К';M[41]='а';M[42]='к';M[43]='-';M[44]='б';M[45]='ы';M[46]=' ';M[47]='д';M[48]='е';M[49]='л';M[50]='о';
M[51]='в';M[52]=' ';M[53]='н';M[54]='а';M[55]=' ';M[56]='н';M[57]='а';M[58]='в';M[59]='о';M[60]='р';M[61]='о';M[62]='т';M[63]='и';M[64]='л';M[65]='и';M[66]='!';M[67]=0; 
  break;
  case 21:
M[0]='2';M[1]='2';M[2]='г';M[3]='о';M[4]='в';M[5]='а';M[6]='р';M[7]='и';M[8]='в';M[9]='а';M[10]='ю';M[11]='т';M[12]=' ';M[13]='х';M[14]='о';M[15]='д';M[16]='о';M[17]='к';M[18]='и';M[19]=' ';M[20]='т';M[21]='а';M[22]='щ';M[23]='а';M[24]='т';M[25]=' ';
M[26]='б';M[27]='о';M[28]='м';M[29]='б';M[30]='у';M[31]=' ';M[32]='в';M[33]=' ';M[34]='з';M[35]='о';M[36]='н';M[37]='у';M[38]='!';M[39]=' ';M[40]='К';M[41]='а';M[42]='к';M[43]='-';M[44]='б';M[45]='ы';M[46]=' ';M[47]='д';M[48]='е';M[49]='л';M[50]='о';
M[51]='в';M[52]=' ';M[53]='н';M[54]='а';M[55]=' ';M[56]='н';M[57]='а';M[58]='в';M[59]='о';M[60]='р';M[61]='о';M[62]='т';M[63]='и';M[64]='л';M[65]='и';M[66]='!';M[67]=0;  
  break;
  case 22:
M[0]='2';M[1]='3';M[2]='г';M[3]='о';M[4]='в';M[5]='а';M[6]='р';M[7]='и';M[8]='в';M[9]='а';M[10]='ю';M[11]='т';M[12]=' ';M[13]='х';M[14]='о';M[15]='д';M[16]='о';M[17]='к';M[18]='и';M[19]=' ';M[20]='т';M[21]='а';M[22]='щ';M[23]='а';M[24]='т';M[25]=' ';
M[26]='б';M[27]='о';M[28]='м';M[29]='б';M[30]='у';M[31]=' ';M[32]='в';M[33]=' ';M[34]='з';M[35]='о';M[36]='н';M[37]='у';M[38]='!';M[39]=' ';M[40]='К';M[41]='а';M[42]='к';M[43]='-';M[44]='б';M[45]='ы';M[46]=' ';M[47]='д';M[48]='е';M[49]='л';M[50]='о';
M[51]='в';M[52]=' ';M[53]='н';M[54]='а';M[55]=' ';M[56]='н';M[57]='а';M[58]='в';M[59]='о';M[60]='р';M[61]='о';M[62]='т';M[63]='и';M[64]='л';M[65]='и';M[66]='!';M[67]=0;
  break;
  case 23:
M[0]='2';M[1]='4';M[2]='г';M[3]='о';M[4]='в';M[5]='а';M[6]='р';M[7]='и';M[8]='в';M[9]='а';M[10]='ю';M[11]='т';M[12]=' ';M[13]='х';M[14]='о';M[15]='д';M[16]='о';M[17]='к';M[18]='и';M[19]=' ';M[20]='т';M[21]='а';M[22]='щ';M[23]='а';M[24]='т';M[25]=' ';
M[26]='б';M[27]='о';M[28]='м';M[29]='б';M[30]='у';M[31]=' ';M[32]='в';M[33]=' ';M[34]='з';M[35]='о';M[36]='н';M[37]='у';M[38]='!';M[39]=' ';M[40]='К';M[41]='а';M[42]='к';M[43]='-';M[44]='б';M[45]='ы';M[46]=' ';M[47]='д';M[48]='е';M[49]='л';M[50]='о';
M[51]='в';M[52]=' ';M[53]='н';M[54]='а';M[55]=' ';M[56]='н';M[57]='а';M[58]='в';M[59]='о';M[60]='р';M[61]='о';M[62]='т';M[63]='и';M[64]='л';M[65]='и';M[66]='!';M[67]=0;
  break;
  case 24:
M[0]='2';M[1]='5';M[2]='г';M[3]='о';M[4]='в';M[5]='а';M[6]='р';M[7]='и';M[8]='в';M[9]='а';M[10]='ю';M[11]='т';M[12]=' ';M[13]='х';M[14]='о';M[15]='д';M[16]='о';M[17]='к';M[18]='и';M[19]=' ';M[20]='т';M[21]='а';M[22]='щ';M[23]='а';M[24]='т';M[25]=' ';
M[26]='б';M[27]='о';M[28]='м';M[29]='б';M[30]='у';M[31]=' ';M[32]='в';M[33]=' ';M[34]='з';M[35]='о';M[36]='н';M[37]='у';M[38]='!';M[39]=' ';M[40]='К';M[41]='а';M[42]='к';M[43]='-';M[44]='б';M[45]='ы';M[46]=' ';M[47]='д';M[48]='е';M[49]='л';M[50]='о';
M[51]='в';M[52]=' ';M[53]='н';M[54]='а';M[55]=' ';M[56]='н';M[57]='а';M[58]='в';M[59]='о';M[60]='р';M[61]='о';M[62]='т';M[63]='и';M[64]='л';M[65]='и';M[66]='!';M[67]=0;
  break;
}
if (DisplayPage<25)  for (int i=0;M[i]!=0;i++) display.write(M[i]);
else for (int i=0;MA[i]!=0;i++) display.write(MA[i]);

}

void PrintArtefaktInfo() {
if (Artefakt) {
 switch (ArtefaktID) {
 case 1:
  break;
  case 2:
  break;
  case 3:
  break;
  case 4:
  break;
  case 5:
  break;
  case 6:
  break;
  case 7:
  break;
  case 8:
  break;
  case 9:
  break;
  case 10:
  break;
  case 11:
  break;
  
 }
}
}

void PrintZarazaMessage() {
byte Zar=0;
display.setCursor(0,8);
for (int i=0;i<10;i++) if (ZarazaMas[i]) Zar=i;
switch (Zar) {
  case 0:
M[0]='П';M[1]='о';M[2]='я';M[3]='в';M[4]='и';M[5]='л';M[6]='а';M[7]='с';M[8]='ь';M[9]=' ';M[10]='с';M[11]='т';M[12]='р';M[13]='а';M[14]='н';M[15]='н';M[16]='а';M[17]='я';M[18]=' ';M[19]='с';M[20]='ы';M[21]='п';M[22]='ь';M[23]=',';M[24]=' ';M[25]='х';
M[26]='е';M[27]='р';M[28]='о';M[29]='в';M[30]='о';M[31]=' ';M[32]='с';M[33]='е';M[34]='б';M[35]='я';M[36]=' ';M[37]='ч';M[38]='у';M[39]='в';M[40]='с';M[41]='т';M[42]='в';M[43]='у';M[44]='ю';M[45]='.';M[46]=' ';M[47]='Н';M[48]='а';M[49]='д';M[50]='о';
M[51]=' ';M[52]='б';M[53]='е';M[54]='ж';M[55]='а';M[56]='т';M[57]='ь';M[58]=' ';M[59]='к';M[60]=' ';M[61]='у';M[62]='ч';M[63]='е';M[64]='н';M[65]='ы';M[66]='м';M[67]='!';M[68]='!';M[69]='1';M[70]=0;
  break;
  case 1:
  M[0]='П';M[1]='о';M[2]='я';M[3]='в';M[4]='и';M[5]='л';M[6]='а';M[7]='с';M[8]='ь';M[9]=' ';M[10]='с';M[11]='т';M[12]='р';M[13]='а';M[14]='н';M[15]='н';M[16]='а';M[17]='я';M[18]=' ';M[19]='с';M[20]='ы';M[21]='п';M[22]='ь';M[23]=',';M[24]=' ';M[25]='х';
M[26]='е';M[27]='р';M[28]='о';M[29]='в';M[30]='о';M[31]=' ';M[32]='с';M[33]='е';M[34]='б';M[35]='я';M[36]=' ';M[37]='ч';M[38]='у';M[39]='в';M[40]='с';M[41]='т';M[42]='в';M[43]='у';M[44]='ю';M[45]='.';M[46]=' ';M[47]='Н';M[48]='а';M[49]='д';M[50]='о';
M[51]=' ';M[52]='б';M[53]='е';M[54]='ж';M[55]='а';M[56]='т';M[57]='ь';M[58]=' ';M[59]='к';M[60]=' ';M[61]='у';M[62]='ч';M[63]='е';M[64]='н';M[65]='ы';M[66]='м';M[67]='!';M[68]='!';M[69]='2';M[70]=0;
  break;
  case 2:
  M[0]='П';M[1]='о';M[2]='я';M[3]='в';M[4]='и';M[5]='л';M[6]='а';M[7]='с';M[8]='ь';M[9]=' ';M[10]='с';M[11]='т';M[12]='р';M[13]='а';M[14]='н';M[15]='н';M[16]='а';M[17]='я';M[18]=' ';M[19]='с';M[20]='ы';M[21]='п';M[22]='ь';M[23]=',';M[24]=' ';M[25]='х';
M[26]='е';M[27]='р';M[28]='о';M[29]='в';M[30]='о';M[31]=' ';M[32]='с';M[33]='е';M[34]='б';M[35]='я';M[36]=' ';M[37]='ч';M[38]='у';M[39]='в';M[40]='с';M[41]='т';M[42]='в';M[43]='у';M[44]='ю';M[45]='.';M[46]=' ';M[47]='Н';M[48]='а';M[49]='д';M[50]='о';
M[51]=' ';M[52]='б';M[53]='е';M[54]='ж';M[55]='а';M[56]='т';M[57]='ь';M[58]=' ';M[59]='к';M[60]=' ';M[61]='у';M[62]='ч';M[63]='е';M[64]='н';M[65]='ы';M[66]='м';M[67]='!';M[68]='!';M[69]='3';M[70]=0;
  break;
  case 3:
  M[0]='П';M[1]='о';M[2]='я';M[3]='в';M[4]='и';M[5]='л';M[6]='а';M[7]='с';M[8]='ь';M[9]=' ';M[10]='с';M[11]='т';M[12]='р';M[13]='а';M[14]='н';M[15]='н';M[16]='а';M[17]='я';M[18]=' ';M[19]='с';M[20]='ы';M[21]='п';M[22]='ь';M[23]=',';M[24]=' ';M[25]='х';
M[26]='е';M[27]='р';M[28]='о';M[29]='в';M[30]='о';M[31]=' ';M[32]='с';M[33]='е';M[34]='б';M[35]='я';M[36]=' ';M[37]='ч';M[38]='у';M[39]='в';M[40]='с';M[41]='т';M[42]='в';M[43]='у';M[44]='ю';M[45]='.';M[46]=' ';M[47]='Н';M[48]='а';M[49]='д';M[50]='о';
M[51]=' ';M[52]='б';M[53]='е';M[54]='ж';M[55]='а';M[56]='т';M[57]='ь';M[58]=' ';M[59]='к';M[60]=' ';M[61]='у';M[62]='ч';M[63]='е';M[64]='н';M[65]='ы';M[66]='м';M[67]='!';M[68]='!';M[69]='4';M[70]=0;
  break;
  case 4: 
  M[0]='П';M[1]='о';M[2]='я';M[3]='в';M[4]='и';M[5]='л';M[6]='а';M[7]='с';M[8]='ь';M[9]=' ';M[10]='с';M[11]='т';M[12]='р';M[13]='а';M[14]='н';M[15]='н';M[16]='а';M[17]='я';M[18]=' ';M[19]='с';M[20]='ы';M[21]='п';M[22]='ь';M[23]=',';M[24]=' ';M[25]='х';
M[26]='е';M[27]='р';M[28]='о';M[29]='в';M[30]='о';M[31]=' ';M[32]='с';M[33]='е';M[34]='б';M[35]='я';M[36]=' ';M[37]='ч';M[38]='у';M[39]='в';M[40]='с';M[41]='т';M[42]='в';M[43]='у';M[44]='ю';M[45]='.';M[46]=' ';M[47]='Н';M[48]='а';M[49]='д';M[50]='о';
M[51]=' ';M[52]='б';M[53]='е';M[54]='ж';M[55]='а';M[56]='т';M[57]='ь';M[58]=' ';M[59]='к';M[60]=' ';M[61]='у';M[62]='ч';M[63]='е';M[64]='н';M[65]='ы';M[66]='м';M[67]='!';M[68]='!';M[69]='5';M[70]=0;
  break;
  case 5:
  M[0]='П';M[1]='о';M[2]='я';M[3]='в';M[4]='и';M[5]='л';M[6]='а';M[7]='с';M[8]='ь';M[9]=' ';M[10]='с';M[11]='т';M[12]='р';M[13]='а';M[14]='н';M[15]='н';M[16]='а';M[17]='я';M[18]=' ';M[19]='с';M[20]='ы';M[21]='п';M[22]='ь';M[23]=',';M[24]=' ';M[25]='х';
M[26]='е';M[27]='р';M[28]='о';M[29]='в';M[30]='о';M[31]=' ';M[32]='с';M[33]='е';M[34]='б';M[35]='я';M[36]=' ';M[37]='ч';M[38]='у';M[39]='в';M[40]='с';M[41]='т';M[42]='в';M[43]='у';M[44]='ю';M[45]='.';M[46]=' ';M[47]='Н';M[48]='а';M[49]='д';M[50]='о';
M[51]=' ';M[52]='б';M[53]='е';M[54]='ж';M[55]='а';M[56]='т';M[57]='ь';M[58]=' ';M[59]='к';M[60]=' ';M[61]='у';M[62]='ч';M[63]='е';M[64]='н';M[65]='ы';M[66]='м';M[67]='!';M[68]='!';M[69]='6';M[70]=0;
  break;
  case 6:
  M[0]='П';M[1]='о';M[2]='я';M[3]='в';M[4]='и';M[5]='л';M[6]='а';M[7]='с';M[8]='ь';M[9]=' ';M[10]='с';M[11]='т';M[12]='р';M[13]='а';M[14]='н';M[15]='н';M[16]='а';M[17]='я';M[18]=' ';M[19]='с';M[20]='ы';M[21]='п';M[22]='ь';M[23]=',';M[24]=' ';M[25]='х';
M[26]='е';M[27]='р';M[28]='о';M[29]='в';M[30]='о';M[31]=' ';M[32]='с';M[33]='е';M[34]='б';M[35]='я';M[36]=' ';M[37]='ч';M[38]='у';M[39]='в';M[40]='с';M[41]='т';M[42]='в';M[43]='у';M[44]='ю';M[45]='.';M[46]=' ';M[47]='Н';M[48]='а';M[49]='д';M[50]='о';
M[51]=' ';M[52]='б';M[53]='е';M[54]='ж';M[55]='а';M[56]='т';M[57]='ь';M[58]=' ';M[59]='к';M[60]=' ';M[61]='у';M[62]='ч';M[63]='е';M[64]='н';M[65]='ы';M[66]='м';M[67]='!';M[68]='!';M[69]='7';M[70]=0;
  break;
  case 7:
  M[0]='П';M[1]='о';M[2]='я';M[3]='в';M[4]='и';M[5]='л';M[6]='а';M[7]='с';M[8]='ь';M[9]=' ';M[10]='с';M[11]='т';M[12]='р';M[13]='а';M[14]='н';M[15]='н';M[16]='а';M[17]='я';M[18]=' ';M[19]='с';M[20]='ы';M[21]='п';M[22]='ь';M[23]=',';M[24]=' ';M[25]='х';
M[26]='е';M[27]='р';M[28]='о';M[29]='в';M[30]='о';M[31]=' ';M[32]='с';M[33]='е';M[34]='б';M[35]='я';M[36]=' ';M[37]='ч';M[38]='у';M[39]='в';M[40]='с';M[41]='т';M[42]='в';M[43]='у';M[44]='ю';M[45]='.';M[46]=' ';M[47]='Н';M[48]='а';M[49]='д';M[50]='о';
M[51]=' ';M[52]='б';M[53]='е';M[54]='ж';M[55]='а';M[56]='т';M[57]='ь';M[58]=' ';M[59]='к';M[60]=' ';M[61]='у';M[62]='ч';M[63]='е';M[64]='н';M[65]='ы';M[66]='м';M[67]='!';M[68]='!';M[69]='8';M[70]=0;
  break;
  case 8:
  M[0]='П';M[1]='о';M[2]='я';M[3]='в';M[4]='и';M[5]='л';M[6]='а';M[7]='с';M[8]='ь';M[9]=' ';M[10]='с';M[11]='т';M[12]='р';M[13]='а';M[14]='н';M[15]='н';M[16]='а';M[17]='я';M[18]=' ';M[19]='с';M[20]='ы';M[21]='п';M[22]='ь';M[23]=',';M[24]=' ';M[25]='х';
M[26]='е';M[27]='р';M[28]='о';M[29]='в';M[30]='о';M[31]=' ';M[32]='с';M[33]='е';M[34]='б';M[35]='я';M[36]=' ';M[37]='ч';M[38]='у';M[39]='в';M[40]='с';M[41]='т';M[42]='в';M[43]='у';M[44]='ю';M[45]='.';M[46]=' ';M[47]='Н';M[48]='а';M[49]='д';M[50]='о';
M[51]=' ';M[52]='б';M[53]='е';M[54]='ж';M[55]='а';M[56]='т';M[57]='ь';M[58]=' ';M[59]='к';M[60]=' ';M[61]='у';M[62]='ч';M[63]='е';M[64]='н';M[65]='ы';M[66]='м';M[67]='!';M[68]='!';M[69]='9';M[70]=0;
  break;
  case 9:
  M[0]='П';M[1]='о';M[2]='я';M[3]='в';M[4]='и';M[5]='л';M[6]='а';M[7]='с';M[8]='ь';M[9]=' ';M[10]='с';M[11]='т';M[12]='р';M[13]='а';M[14]='н';M[15]='н';M[16]='а';M[17]='я';M[18]=' ';M[19]='с';M[20]='ы';M[21]='п';M[22]='ь';M[23]=',';M[24]=' ';M[25]='х';
M[26]='е';M[27]='р';M[28]='о';M[29]='в';M[30]='о';M[31]=' ';M[32]='с';M[33]='е';M[34]='б';M[35]='я';M[36]=' ';M[37]='ч';M[38]='у';M[39]='в';M[40]='с';M[41]='т';M[42]='в';M[43]='у';M[44]='ю';M[45]='.';M[46]=' ';M[47]='Н';M[48]='а';M[49]='д';M[50]='о';
M[51]=' ';M[52]='б';M[53]='е';M[54]='ж';M[55]='а';M[56]='т';M[57]='ь';M[58]=' ';M[59]='к';M[60]=' ';M[61]='у';M[62]='ч';M[63]='е';M[64]='н';M[65]='ы';M[66]='м';M[67]='!';M[68]='1';M[69]='0';M[70]=0;
  break;
}
for (int i=0;M[i]!=0;i++) display.write(M[i]);

}

void PrintMessage() {
int k=0;
int Tmp2=RadiationLevel*100+1;
int Tmp3=TreatLevel*1000;
int Tmp4=Poison;
int Tmp5=(1-RadiationKoef)*100;
int Tmp6=(1-PoisonKoef)*100;
char KoefRad[3]={0,0,0};
sprintf(KoefRad, "%d", Tmp5);
char KoefPois[3]={0,0,0};
sprintf(KoefPois, "%d", Tmp6);
char PoisonLev[3]={0,0,0};
sprintf(PoisonLev, "%d", Tmp4);
char Fon[4]={0,0,0,0};
sprintf(Fon, "%d", Tmp2);
for (k=0;Fon[3] == 0;k++) {
 Fon[3]=Fon[2];
 Fon[2]=Fon[1];
 Fon[1]=Fon[0];
 Fon[k]='0';
}
char TreatLev[4]={0,0,0,0};
sprintf(TreatLev, "%d", Tmp3);
for (k=0;TreatLev[3] == 0;k++) {
 TreatLev[3]=TreatLev[2];
 TreatLev[2]=TreatLev[1];
 TreatLev[1]=TreatLev[0];
 TreatLev[k]='0';
}

if (!Deadh)
        if (DisplayPage==31) {
            if (Zaraza && DisplayChange) {
            PrintZarazaMessage();
            } else {
            display.setCursor(0, 8);
            display.write('Ф');display.write('о');display.write('н');display.write(':');display.write(Fon[0]);display.write(Fon[1]);display.write(',');display.write(Fon[2]);display.write(Fon[3]);
            display.write('м');display.write('к');display.write('З');display.write(47);display.write('м');
            display.setCursor(0, 16);
            display.write('Я');display.write('д');display.write(':');display.write('-');display.write(PoisonLev[0]);display.write(PoisonLev[1]);display.write(PoisonLev[2]);display.write('ж');display.write('/');display.write('м');
            display.setCursor(0, 24);
            display.write('Б');display.write('л');display.write('а');display.write('г');display.write('о');display.write(':');display.write(TreatLev[0]);display.write(',');
            display.write(TreatLev[1]);display.write(TreatLev[2]);display.write(TreatLev[3]);display.write('ж');display.write('/');display.write('с');
            display.setCursor(0, 32);
            display.write('З');display.write('а');display.write('щ');display.write('.');display.write(' ');display.write('Р');display.write('а');display.write('д');display.write('.');display.write(':');
            display.write(KoefRad[0]);display.write(KoefRad[1]);display.write(KoefRad[2]);display.write('%');
            display.setCursor(0, 40);
            display.write('З');display.write('.');display.write(' ');display.write('о');display.write('т');display.write(' ');display.write('я');display.write('д');display.write('а');display.write(':');
            display.write(KoefPois[0]);display.write(KoefPois[1]);display.write(KoefPois[2]);display.write('%');
            // PrintArtefaktInfo();
            }          
        } else {
            PrintSMS();
            }
if (Deadh) {
  if (Treat) {
  display.setCursor(22,20);
  M[0]='Л';M[1]='е';M[2]='ч';M[3]='е';M[4]='н';M[5]='и';M[6]='е';M[7]=0;
 }
  else{
  display.setCursor(0,20);
  M[0]='Т';M[1]='ы';M[2]=' ';M[3]='т';M[4]='р';M[5]='у';M[6]='п';M[7]='!';M[8]=' ';M[9]='И';M[10]='д';M[11]='и';M[12]=' ';M[13]=' ';M[14]='н';M[15]='а';M[16]=' ';M[17]='м';M[18]='е';M[19]='р';M[20]='т';M[21]='в';M[22]='я';M[23]='к';M[24]='!';M[25]=0;
  }
  for (byte i=0;M[i]!=0;i++) display.write(M[i]);
  }
}

void LCD(byte Val) { //Вывод инфы на дисплей
  if (Val==1) PrDisplayLedTime=millis();
  if (Val!=0) {
  char Heal[3]={0,0,0}, Mes[2]={0,0};
  analogWrite(LedPin, DisplayBright);
  sprintf(Heal, "%d", Health);
  sprintf(Mes, "%d", Messages);
  LCD_Sleep=false;
  display.clearDisplay();
  display.setCursor(0, 0);
  //Хэлсы
  if (!Deadh) {
  display.write(95);display.setCursor(5, 0);display.write(96);}
  else display.write(92);
  display.write(Heal[0]);display.write(Heal[1]);display.write(Heal[2]);
  //Звук
  display.setCursor(36, 0);
  if (Mute) display.write(62); else display.write(60);
  //Сообщения
  display.setCursor(48, 0);display.write(93);display.setCursor(53, 0);display.write(94);display.setCursor(62, 0);display.write(Mes[0]);display.write(Mes[1]);
  //батарея
  display.setCursor(78, 0);display.write(BatICO);
  // Основной дисплей
  
PrintMessage();
  display.display(); 
  }   
  if (Val==0) {
    analogWrite(LedPin, 0);
    display.clearDisplay();
    display.display();
    LCD_Sleep=true;
  }
}

void Affect (int Ind) {
  switch (Ind) {
    case 0:
    Health=Health-Poison*PoisonKoef;
    break;
    case 1:
    Health=Health-Poison*PoisonKoef;
    break;
    case 2:
    break;
    case 3:
    break;
    case 4:
    break;
    case 5:
    break;
    case 6:
    break;
    case 7:
    break;
    case 8:
    break;
    case 9:
    break;
  }
}
void AdminDevice(){ //определение подключенного админ устройства
int k;
delay(1000);
int tmp3=analogRead(AdminDevPin);
if (tmp3>80) {
Signal(3);
Device=true;
for (k=0; k<13; k++) if (OutDevice[k] > tmp3) break;
  switch (k) {
    case 1:
    break;
    case 2:
    //2 админ устройство
    break;
    case 3:
    //3 админ устройство
    break;
    case 4:
    //4 админ устройство
    break;
    case 5:
    //5 админ устройство
    break;
    case 6:
    TreatMas[0]=4;
    break;
    case 7:
    Health=100; LCD(1);
    break;
    case 8:
    break;
    case 9:
    //9 админ устройство
    break;
    case 10:
    //10 админ устройство
    break;
    case 11:
    //11 админ устройство
    break;
     
  }
}
}
void ArtefaktDevice(){ //Определение подключенного артефакта
delay(1000);
int tmp3=analogRead(ArtefaktPin);
if (tmp3>80) {
ArtefaktID=0;
Signal(3); 
Artefakt=true;
for (ArtefaktID; ArtefaktID<13; ArtefaktID++) if (OutDevice[ArtefaktID] > tmp3) break;
  switch (ArtefaktID) {
    case 1:
    RadiationKoef=0.1;
    //1 артефакт
    break;
    case 2:
    //2 артефакт
    break;
    case 3:
    //3 артефакт
    break;
    case 4:
    //4 артефакт
    break;
    case 5:
    //5 артефакт
    break;
    case 6:
    //6 артефакт
    TreatMas[3]=1;
    Treat=true;
    RadiationKoef=0.1;
    PoisonKoef=0.5;
    break;
    case 7:
    //7 артефакт
    RadiationMas[1]=0.45;
    Radiation=true;
    break;
    case 8:
    //8 артефакт

    break;
    case 9:
    //9 артефакт
    break;
    case 10:
    //10 артефакт

    break;
    case 11:
    //11 артефакт

    break;
     
  }
}  
}
void ArtefaktEject() { //Убираем воздействие артефакта при его изьятии
  Signal(4);
  switch (ArtefaktID) {
    case 1:
    //1 артефакт
    RadiationKoef=1;
    break;
    case 2:
    //2 артефакт
    break;
    case 3:
    //3 артефакт
    break;
    case 4:
    //4 артефакт
    break;
    case 5:
    //5 артефакт
    break;
    case 6:
    //6 артефакт
    TreatMas[3]=0;
    RadiationKoef=1;
    PoisonKoef=1;
    break;
    case 7:
    //7 артефакт
    RadiationMas[1]=0;
    break;
    case 8:
    //8 артефакт
    break;
    case 9:
    //9 артефакт
    break;
    case 10:
    //10 артефакт
    break;
    case 11:
    //11 артефакт
    break;   
  }
  ArtefaktID=0;
  Artefakt=false;
}
int ReadMessage() {
  int l;
  for (l=0;l<30;l++) {if (MessageMas[l]) break;}
  if (l==29 && !MessageMas[29]) l=31; else {MessageMas[l]=false;if (l<25) ReadMesMas[l]=true;}
return l;
}

void NoReadMessages() {
Messages=0;
for (byte k=0;k<30;k++) if (MessageMas[k]) Messages++; 
}

void Push_Key() {
delay(100);
int tmp4=analogRead(KeysPin);
if (tmp4>100) {
Key=true;
DeadhSignal=false;
  if (tmp4 < KeysACP[0]+15 && tmp4 > KeysACP[0]-15) {
    if (!LCD_Sleep && DisplayPage!=31) {DisplayPage=31;LCD(1);}
    else if (!LCD_Sleep && DisplayPage==31) LCD(0);
    else if (LCD_Sleep) LCD(1);
  } 
  if (tmp4 < KeysACP[1]+15 && tmp4 > KeysACP[1]-15) {
    if (!LCD_Sleep) { 
      if (DisplayPage==31) LCD(0);
      if (Messages>0) {
        if (DisplayPage!=31) {
          if (Messages==0) DisplayPage=31;
          else DisplayPage=ReadMessage();
          LCD(1);
        }
        else {DisplayPage=ReadMessage();LCD(1);}
      } else {DisplayPage=31;}
    
    }
    else LCD(1);
    NoReadMessages();
} 
  if (tmp4 < KeysACP[2]+15 && tmp4 > KeysACP[2]-15) {if (Mute) Mute=false; else Mute=true;LCD(1);} 
  if (tmp4 < KeysACP[3]+15 && tmp4 > KeysACP[3]-15) {if (DisplayBright>=230) DisplayBright=0; else DisplayBright+=50;LCD(1);} 
  if (tmp4 < KeysACP[4]+15 && tmp4 > KeysACP[4]-15) {if (!Deadh) Deadh_Stalker();} 
 
}
}



void loop() { //прога

if (millis() - PrMillisDisplayRefresh > 1000) {
  PrMillisDisplayRefresh=millis();LCD_Refresh();
}
  
 if (millis()-PrMillisChangeDisplayPg >= 5000) {
  PrMillisChangeDisplayPg=millis(); 
  if (DisplayChange) DisplayChange=false; else DisplayChange=true;
 }
  GetMes();TransmitRadiation();
  // Проверка батарейки
  if (millis()-PrMillisBat > 30000) {
    PrMillisBat=millis();
    Volt=GetVoltage(VbatPin, 6.8, 8.0, 2.0);
  }

  if (millis() - PrDisplayLedTime > DisplayLedTime && !LCD_Sleep) {
    LCD(0);
  }

if (!Deadh) {  
// Проверка радиации, если есть - сложение всех радиаций в одно значение
    if (Radiation) {
      RadiationLevel=0;
      for (byte i=0; i<3; i++) {
        RadiationLevel=RadiationLevel+RadiationMas[i];
      }
      if (RadiationLevel==0) {Radiation=false;LCD_Refresh();};
    }

// Если есть радиация - воздействовать на игрока 
    if (RadiationLevel > 0) {
      if (!Radiation_res) {Radiation_res=true;PrMillisRad=millis();}
      Radiation_zone(1, int(1/RadiationLevel*1000)/RadiationKoef);
      SignalRadiation();
    }
      else {Radiation_res=false;LCD_Refresh();};
}


// Если есть лечилка - сложение значений всех лечилок
    if (Treat) {
      TreatLevel=0;
      for (byte i=0; i<4; i++) {
        TreatLevel=TreatLevel+TreatMas[i];}
      if (TreatLevel==0) {Treat=false;LCD(1);};
    }
if (Health<100) {
// Если есть лечилка - воздействовать на игрока 
    if (TreatLevel > 0) {
      if (!Treat_res) {Treat_res=true;PrMillisTreat=millis();}
      Treat_zone(1, long(1/TreatLevel*1000));
    }
      else {Treat_res=false;};
}
// Отслеживание вредных воздействий
    if (millis()-PrMillisAffect>60000) {
      PrMillisAffect=millis();
      for (byte i=0;i<10;i++) {if (ZarazaMas[i]) {Affect(i);SignalAffect=true;}}
    if (SignalAffect) Signal(7);
    if (DeadhSignal && Deadh) Signal(1);
    LCD_Refresh();
    }

// Если изменилось значение жизни - отобразить на дисплее и проверить не умер ли или воскрес  
  if (PrHealth > Health) {Life();LCD_Refresh();PrHealth=Health;}
  if (PrHealth < Health) {Life();PrHealth=Health;LCD_Refresh();}
  
// Отслеживание кнопок
 if (analogRead(KeysPin) > 100) {
   if (!Key) Push_Key();
 }
 else Key=false;

 
// Отслеживание админских модулей
  
  if (analogRead(AdminDevPin) > 80) {
    if (!Device) AdminDevice();
  }
  else {Device=false;};

 // Отслеживание Артефактов
  if (analogRead(ArtefaktPin) > 80 && !Deadh) {
    if (!Artefakt) ArtefaktDevice();
  }
  else {
  Artefakt=false;
  if (ArtefaktID!=0) ArtefaktEject();
  }
      
}

